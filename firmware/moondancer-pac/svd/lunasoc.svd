# lunasoc register map
Vendor: amaranth-soc
Registers are 32-bit, read-write, reset 0x0 unless marked. A register's access mark holds for its fields unless they carry their own. Offsets are from the block's base; [hi:lo] are bit positions.

## GPIOB
Base 0xF0002100
0x00 moder — gpiob moder register
  [7:0] moder
0x04 odr wo — gpiob odr register
  [7:0] odr
0x08 idr ro — gpiob idr register
  [7:0] idr
0x10 ev_status ro — gpiob ev_status register
  [0] status — gpiob status register field
0x14 ev_pending — gpiob ev_pending register
  [0] pending — gpiob pending register field
0x18 ev_enable — gpiob ev_enable register
  [0] enable — gpiob enable register field

## USB0
Base 0xF0003000
0x00 connect — usb0 connect register
  [0] connect — Set this bit to '1' to allow the associated USB device to connect to a host.
0x04 speed ro — usb0 speed register
  [1:0] speed — Indicates the current speed of the USB device. 0 indicates High; 1 => Full, 2 => Low, and 3 => SuperSpeed (incl SuperSpeed+).
0x08 low_speed_only — usb0 low_speed_only register
  [0] low_speed_only — Set this bit to '1' to force the device to operate at low speed.
0x0C full_speed_only — usb0 full_speed_only register
  [0] full_speed_only — Set this bit to '1' to force the device to operate at full speed.
0x10 ev_status ro — usb0 ev_status register
  [0] status — usb0 status register field
0x14 ev_pending — usb0 ev_pending register
  [0] pending — usb0 pending register field
0x18 ev_enable — usb0 ev_enable register
  [0] enable — usb0 enable register field

## USB0_EP_CONTROL
Base 0xF0003040
0x00 data ro — usb0_ep_control data register
  [7:0] data — A FIFO that returns the bytes from the most recently captured SETUP packet. Reading a byte from this register advances the FIFO. The first eight bytes read from this contain the core SETUP packet.
0x04 reset wo — usb0_ep_control reset register
  [0] reset — Local reset control for the SETUP handler; writing a '1' to this register clears the handler state.
0x08 epno ro — usb0_ep_control epno register
  [3:0] epno — The endpoint number associated with the most recently captured SETUP packet.
0x0C have ro — usb0_ep_control have register
  [0] have — `1` iff data is available in the FIFO.
0x10 pend ro — usb0_ep_control pend register
  [0] pend — `1` iff an interrupt is pending
0x14 address — usb0_ep_control address register
  [7:0] address — Controls the current device's USB address. Should be written after a SET_ADDRESS request is received. Automatically resets back to zero on a USB reset.
0x20 ev_status ro — usb0_ep_control ev_status register
  [0] status — usb0_ep_control status register field
0x24 ev_pending — usb0_ep_control ev_pending register
  [0] pending — usb0_ep_control pending register field
0x28 ev_enable — usb0_ep_control ev_enable register
  [0] enable — usb0_ep_control enable register field

## USB0_EP_IN
Base 0xF0003080
0x00 data wo — usb0_ep_in data register
  [7:0] data — Write-only register. Each write enqueues a byte to be transmitted; gradually building a single packet to be transmitted. This queue should only ever contain a single packet; it is the software's responsibility to handle breaking requests down into packets.
0x04 epno — usb0_ep_in epno register
  [3:0] epno — Contains the endpoint the enqueued packet is to be transmitted on. Writing this register marks the relevant packet as ready to transmit; and thus should only be written after a full packet has been written into the FIFO. If no data has been placed into the DATA FIFO, a zero-length packet is generated. Note that any IN requests that do not match the endpoint number are automatically NAK'd.
0x08 reset wo — usb0_ep_in reset register
  [0] reset — A write to this register clears the FIFO without transmitting.
0x0C stall — usb0_ep_in stall register
  [0] stall — When this register contains '1', any IN tokens targeting `epno` will be responded to with a STALL token, rather than DATA or a NAK. For EP0, this register will automatically be cleared when a new SETUP token is received.
0x10 idle ro — usb0_ep_in idle register
  [0] idle — This value is `1` if no packet is actively being transmitted.
0x14 have ro — usb0_ep_in have register
  [0] have — This value is `1` if data is present in the transmit FIFO.
0x18 pend ro — usb0_ep_in pend register
  [0] pend — `1` iff an interrupt is pending
0x1C pid — usb0_ep_in pid register
  [0] pid — Contains the current PID toggle bit for the given endpoint.
0x20 nak ro — usb0_ep_in nak register
  [15:0] nak — Read-only register. Contains a bitmask of endpoints that have responded with a NAK since the last read of this register.
0x40 ev_status ro — usb0_ep_in ev_status register
  [0] status — usb0_ep_in status register field
0x44 ev_pending — usb0_ep_in ev_pending register
  [0] pending — usb0_ep_in pending register field
0x48 ev_enable — usb0_ep_in ev_enable register
  [0] enable — usb0_ep_in enable register field
