# lunasoc register map
Vendor: amaranth-soc
Registers are 32-bit, read-write, reset 0x0 unless marked. A register's access mark holds for its fields unless they carry their own. Offsets are from the block's base; [hi:lo] are bit positions.

## USB2_EP_OUT
Base 0xF0005100
0x00 data ro — usb2_ep_out data register
  [7:0] data — A FIFO that returns the bytes from the most recently captured OUT transaction. Reading a byte from this register advances the FIFO.
0x04 data_ep ro — usb2_ep_out data_ep register
  [3:0] data_ep — Register that contains the endpoint number associated with the data in the FIFO -- that is, the endpoint number on which the relevant data was received.
0x08 reset wo — usb2_ep_out reset register
  [0] reset — Local reset for the OUT handler; clears the out FIFO.
0x0C epno — usb2_ep_out epno register
  [3:0] epno — Selects the endpoint number to prime. This interface only allows priming a single endpoint at once-- that is, only one endpoint can be ready to receive data at a time. See the `enable` bit for usage.
0x10 enable — usb2_ep_out enable register
  [0] enable — Controls whether any data can be received on any primed OUT endpoint. This bit is automatically cleared on receive in order to give the controller time to read data from the FIFO. It must be re-enabled once the FIFO has been emptied.
0x14 prime wo — usb2_ep_out prime register
  [0] prime — Controls "priming" an out endpoint. To receive data on any endpoint, the CPU must first select the endpoint with the `epno` register; and then write a '1' into the prime and enable register. This prepares our FIFO to receive data; and the next OUT transaction will be captured into the FIFO. When a transaction is complete, the `enable` bit is reset; the `prime` is not. This effectively means that `enable` controls receiving on _any_ of the primed endpoints; while `prime` can be used to build a collection of endpoints willing to participate in receipt. Only one transaction / data packet is captured per `enable` write; repeated enabling is necessary to capture multiple packets.
0x18 stall — usb2_ep_out stall register
  [0] stall — Controls STALL'ing the active endpoint. Setting or clearing this bit will set or clear STALL on the provided endpoint. Endpoint STALLs persist even after `epno` is changed; so multiple endpoints can be stalled at once by writing their respective endpoint numbers into `epno` register and then setting their `stall` bits.
0x1C have ro — usb2_ep_out have register
  [0] have — `1` iff data is available in the FIFO.
0x20 pend ro — usb2_ep_out pend register
  [0] pend — `1` iff an interrupt is pending
0x24 address — usb2_ep_out address register
  [7:0] address — Controls the current device's USB address. Should be written after a SET_ADDRESS request is received. Automatically resets back to zero on a USB reset.
0x28 pid — usb2_ep_out pid register
  [0] pid — Contains the current PID toggle bit for the given endpoint.
0x40 ev_status ro — usb2_ep_out ev_status register
  [0] status — usb2_ep_out status register field
0x44 ev_pending — usb2_ep_out ev_pending register
  [0] pending — usb2_ep_out pending register field
0x48 ev_enable — usb2_ep_out ev_enable register
  [0] enable — usb2_ep_out enable register field

## UART1
Base 0xF0006000
0x00 divisor — uart1 divisor register
  [9:0] divisor — uart1 divisor register field
0x04 rx_data ro — uart1 rx_data register
  [7:0] rx_data — uart1 rx_data register field
0x08 rx_rdy ro — uart1 rx_rdy register
  [0] rx_rdy — uart1 rx_rdy register field
0x0C rx_err ro — uart1 rx_err register
  [2:0] rx_err — uart1 rx_err register field
0x10 tx_data wo — uart1 tx_data register
  [7:0] tx_data — uart1 tx_data register field
0x14 tx_rdy ro — uart1 tx_rdy register
  [0] tx_rdy — uart1 tx_rdy register field
0x20 ev_status ro — uart1 ev_status register
  [2:0] status — uart1 status register field
0x24 ev_pending — uart1 ev_pending register
  [2:0] pending — uart1 pending register field
0x28 ev_enable — uart1 ev_enable register
  [2:0] enable — uart1 enable register field

## ADVERTISER
Base 0xF0007000
0x00 enable — advertiser enable register
  [0] enable — Set this bit to '1' to start ApolloAdvertiser and disconnect the Cynthion USB control port from Apollo.

## INFO
Base 0xF0007100
0x00 version_major ro — info version_major register
  [7:0] version_major — Contains the Cynthion hardware major revision number.
0x04 version_minor ro — info version_minor register
  [7:0] version_minor — Contains the Cynthion hardware minor revision number.
